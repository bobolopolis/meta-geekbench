## conf/layer.conf
```bitbake
BBPATH .= ":${LAYERDIR}"

BBFILES += "${LAYERDIR}/recipes*/*/*.bb ${LAYERDIR}/recipes*/*/*.bbappend"

BBFILE_COLLECTIONS += "geekbench"
BBFILE_PATTERN_geekbench := "^${LAYERDIR}/"
BBFILE_PRIORITY_geekbench = "10"
LAYERSERIES_COMPAT_geekbench = "nanbield mickledore langdale kirkstone dunfell"
```
